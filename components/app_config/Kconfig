## components/app_config/Kconfig
```kconfig
menu "WeMos R32 application"

    config APP_DEVICE_NAME
        string "Device name"
        default "WeMosR32"
        help
            Human-readable device name returned by the status API.

    config APP_WIFI_AP_SSID
        string "SoftAP SSID"
        default "WeMosR32"
        help
            SSID broadcast by the device.

    config APP_WIFI_AP_PASSWORD
        string "SoftAP password"
        default "wemosr32"
        help
            WPA2 password for the SoftAP. Use at least 8 characters.
            An empty value creates an open network.

    config APP_WIFI_AP_CHANNEL
        int "SoftAP channel"
        range 1 13
        default 1

    config APP_WIFI_STA_ENABLED
        bool "Enable station mode"
        default n
        help
            Keep the device connected to an existing Wi-Fi network.
            SoftAP remains enabled so local configuration is always available.

    config APP_WIFI_STA_SSID
        string "Station SSID"
        default ""
        depends on APP_WIFI_STA_ENABLED

    config APP_WIFI_STA_PASSWORD
        string "Station password"
        default ""
        depends on APP_WIFI_STA_ENABLED
        help
            Leave empty for an open network.

    config APP_HTTP_SERVER_ENABLED
        bool "Enable HTTP status API"
        default y
        help
            Starts a small HTTP server on both the SoftAP and station interfaces.

    config APP_WELLNESS_ENABLED
        bool "Enable PIR, SHT30, OLED and sedentary reminder"
        default y
        help
            Starts the wellness monitor task, SSD1306 status display and
            sedentary reminder. Sensor failures are logged but do not stop
            Wi-Fi or the HTTP status server.

    config APP_PIR_GPIO
        int "PIR OUT GPIO"
        range 0 39
        default 27
        depends on APP_WELLNESS_ENABLED
        help
            GPIO connected to the PIR module digital output. The default is
            safe for ESP32-WROOM boards; avoid GPIO6-11 used by flash.

    config APP_SHT30_UART_PORT
        int "SHT30 UART port"
        range 1 2
        default 2
        depends on APP_WELLNESS_ENABLED
        help
            UART peripheral used by the SmartMCU serial SHT30 module.
            UART0 is reserved for the ESP-IDF console.

    config APP_SHT30_UART_TX_GPIO
        int "SHT30 UART TX GPIO"
        range 0 39
        default 17
        depends on APP_WELLNESS_ENABLED
        help
            ESP32 TX pin connected to the SHT30 module RXD pin.

    config APP_SHT30_UART_RX_GPIO
        int "SHT30 UART RX GPIO"
        range 0 39
        default 16
        depends on APP_WELLNESS_ENABLED
        help
            ESP32 RX pin connected to the SHT30 module TXD pin.

    config APP_OLED_I2C_PORT
        int "OLED I2C port"
        range 0 1
        default 0
        depends on APP_WELLNESS_ENABLED

    config APP_OLED_I2C_SDA_GPIO
        int "OLED I2C SDA GPIO"
        range 0 39
        default 21
        depends on APP_WELLNESS_ENABLED

    config APP_OLED_I2C_SCL_GPIO
        int "OLED I2C SCL GPIO"
        range 0 39
        default 22
        depends on APP_WELLNESS_ENABLED

    config APP_OLED_I2C_FREQ_HZ
        int "OLED I2C clock frequency"
        range 100000 400000
        default 100000
        depends on APP_WELLNESS_ENABLED

    choice APP_OLED_CONTROLLER
        prompt "OLED controller"
        default APP_OLED_CONTROLLER_SH1106
        depends on APP_WELLNESS_ENABLED
        help
            Select the controller used by the 128x64 OLED module. Most 1.3
            inch I2C modules use SH1106. SSD1306 and SSD1315-compatible
            modules use the SSD1306 command set. This cannot be identified
            reliably over I2C, so select the controller from the module
            listing or board documentation.

        config APP_OLED_CONTROLLER_SSD1306
            bool "SSD1306 or SSD1315 compatible"

        config APP_OLED_CONTROLLER_SH1106
            bool "SH1106"
    endchoice

    config APP_BUZZER_ENABLED
        bool "Enable active buzzer feedback"
        default y
        depends on APP_WELLNESS_ENABLED
        help
            Drives the active-high buzzer service for sedentary and water
            reminders. Disable this when no buzzer is connected; the OLED
            and HTTP status still show reminder state.

    config APP_BUZZER_GPIO
        int "Active buzzer GPIO"
        range 0 39
        default 25
        depends on APP_BUZZER_ENABLED

    config APP_VIBRATION_ENABLED
        bool "Enable vibration motor feedback"
        default y
        depends on APP_WELLNESS_ENABLED
        help
            Drives the vibration service through a three-wire motor module
            with an active-high IN input. Do not connect a bare two-wire
            motor directly to an ESP32 GPIO; use a transistor or MOSFET
            driver with a flyback diode.

    config APP_VIBRATION_GPIO
        int "Vibration motor IN GPIO"
        range 0 39
        default 26
        depends on APP_VIBRATION_ENABLED
        help
            GPIO connected to the motor module IN input. GPIO26 is used by
            default and is independent from the buzzer on GPIO25.

    config APP_RGB_LED_ENABLED
        bool "Enable RGB indicator LED"
        default y
        depends on APP_WELLNESS_ENABLED
        help
            Drives a common-cathode RGB LED through three LEDC PWM channels.
            The R, G and B inputs are active-high. Use series resistors when
            the LED module does not already provide current limiting.

    config APP_RGB_LED_RED_GPIO
        int "RGB red GPIO"
        range 0 39
        default 4
        depends on APP_RGB_LED_ENABLED

    config APP_RGB_LED_GREEN_GPIO
        int "RGB green GPIO"
        range 0 39
        default 19
        depends on APP_RGB_LED_ENABLED

    config APP_RGB_LED_BLUE_GPIO
        int "RGB blue GPIO"
        range 0 39
        default 18
        depends on APP_RGB_LED_ENABLED

    config APP_BUTTONS_ENABLED
        bool "Enable four workstation control keys"
        default y
        depends on APP_WELLNESS_ENABLED
        help
            Enables four active-low keys used with the integrated OLED panel.
            The keys remain independent from the desk lamp panel controls.
            K1 acknowledges feedback, K2 records or removes water, K3 controls
            temporary mute and the alert mode, and K4 selects the OLED page.

    config APP_BUTTON_ACK_GPIO
        int "K1 acknowledge GPIO"
        range 0 39
        default 32
        depends on APP_BUTTONS_ENABLED

    config APP_BUTTON_WATER_GPIO
        int "K2 water GPIO"
        range 0 39
        default 33
        depends on APP_BUTTONS_ENABLED

    config APP_BUTTON_MUTE_GPIO
        int "K3 mute GPIO"
        range 0 39
        default 34
        depends on APP_BUTTONS_ENABLED
        help
            GPIO34 is input-only and has no internal pull-up on ESP32. Fit an
            external 10 kOhm pull-up to 3.3 V unless the button board already
            provides one.

    config APP_BUTTON_PAGE_GPIO
        int "K4 display page GPIO"
        range 0 39
        default 35
        depends on APP_BUTTONS_ENABLED
        help
            GPIO35 is input-only and has no internal pull-up on ESP32. Fit an
            external 10 kOhm pull-up to 3.3 V unless the button board already
            provides one.

    config APP_BUTTON_DEBOUNCE_MS
        int "Key debounce interval in milliseconds"
        range 10 100
        default 25
        depends on APP_BUTTONS_ENABLED

    config APP_BUTTON_LONG_PRESS_MS
        int "Key long-press interval in milliseconds"
        range 500 5000
        default 1500
        depends on APP_BUTTONS_ENABLED

    config APP_SEDENTARY_INITIAL_MINUTES
        int "First sedentary alert after minutes"
        range 1 240
        default 45
        depends on APP_WELLNESS_ENABLED

    config APP_SEDENTARY_ESCALATION_MINUTES
        int "Repeat alert interval while seated"
        range 1 60
        default 5
        depends on APP_WELLNESS_ENABLED

    config APP_SEDENTARY_BREAK_MINUTES
        int "Required break duration in minutes"
        range 1 30
        default 3
        depends on APP_WELLNESS_ENABLED

    config APP_SEDENTARY_ABSENCE_SECONDS
        int "No-motion interval before break candidate"
        range 5 300
        default 30
        depends on APP_WELLNESS_ENABLED

    config APP_WORKSTATION_LIGHT_ENABLED
        bool "Enable workstation desk light relay controller"
        default y
        help
            Controls a desk lamp through the first three inputs of a
            four-channel relay module. All three relay contacts are momentary
            and are wired in parallel with the lamp panel's low-voltage power,
            brightness, and color-temperature buttons. The fourth relay is
            intentionally not configured.

    config APP_WORKSTATION_LIGHT_POWER_GPIO
        int "Desk light power relay GPIO"
        range 0 39
        default 13
        depends on APP_WORKSTATION_LIGHT_ENABLED
        help
            GPIO connected to relay input IN1. The default avoids peripherals
            already configured by the application and ESP32 flash pins.

    config APP_WORKSTATION_LIGHT_BRIGHTNESS_GPIO
        int "Desk light brightness relay GPIO"
        range 0 39
        default 14
        depends on APP_WORKSTATION_LIGHT_ENABLED

    config APP_WORKSTATION_LIGHT_COLOR_GPIO
        int "Desk light color relay GPIO"
        range 0 39
        default 23
        depends on APP_WORKSTATION_LIGHT_ENABLED

    config APP_WORKSTATION_LIGHT_RELAY_ACTIVE_LOW
        bool "Relay inputs are active low"
        default y
        depends on APP_WORKSTATION_LIGHT_ENABLED
        help
            Most low-cost relay modules close the contact when an input is
            pulled low. Disable this for active-high relay boards.

    config APP_WORKSTATION_LIGHT_PULSE_MS
        int "Desk light button pulse duration in milliseconds"
        range 40 1000
        default 180
        depends on APP_WORKSTATION_LIGHT_ENABLED
        help
            All three relays are momentary outputs. Keep the pulse short enough
            to emulate the lamp's panel buttons.

    config APP_WORKSTATION_LIGHT_SETTLE_MS
        int "Desk light button release gap in milliseconds"
        range 40 1000
        default 160
        depends on APP_WORKSTATION_LIGHT_ENABLED

    config APP_WORKSTATION_LIGHT_PRESENCE_AUTO
        bool "Turn the desk light on while PIR reports presence"
        default y
        depends on APP_WORKSTATION_LIGHT_ENABLED && APP_WELLNESS_ENABLED
        help
            Pulses relay 1 when the wellness PIR starts reporting presence and
            pulses it again after the presence hold expires. The wellness
            monitor currently holds presence for 120 seconds after the last
            motion. Manual HTTP controls remain available and are not
            continuously overridden while the presence state is unchanged.

    config APP_WORKSTATION_LIGHT_PRESENCE_LED_ENABLED
        bool "Mirror PIR presence on the onboard status LED"
        default y
        depends on APP_WORKSTATION_LIGHT_ENABLED && APP_WELLNESS_ENABLED
        help
            Uses the development board's software-controlled LED as a local
            PIR indicator. On the black Wemos D1 R32 board the controllable
            red LED is connected to GPIO2 and is active high, while the blue
            LED is the 3.3 V power indicator. Disable this option when the
            board does not provide a controllable LED.

    config APP_WORKSTATION_LIGHT_PRESENCE_LED_GPIO
        int "Onboard status LED GPIO"
        range 0 39
        default 2
        depends on APP_WORKSTATION_LIGHT_PRESENCE_LED_ENABLED
        help
            GPIO connected to the onboard software-controlled LED. GPIO2 is
            used by most ESP32-WROOM-32 and Wemos D1 R32 development boards.

    config APP_WORKSTATION_LIGHT_PRESENCE_LED_ACTIVE_LOW
        bool "Onboard status LED is active low"
        default n
        depends on APP_WORKSTATION_LIGHT_PRESENCE_LED_ENABLED
        help
            Enable this when the LED turns on with a low GPIO level. This is
            not the usual wiring on the black Wemos D1 R32 board.

endmenu
```

## sdkconfig.defaults
```kconfig
CONFIG_IDF_TARGET="esp32"
CONFIG_ESPTOOLPY_FLASHSIZE_4MB=y
CONFIG_PARTITION_TABLE_CUSTOM=y
CONFIG_PARTITION_TABLE_CUSTOM_FILENAME="partitions.csv"
CONFIG_ESPTOOLPY_FLASHMODE_DIO=y
CONFIG_ESPTOOLPY_FLASHFREQ_40M=y
CONFIG_APP_VIBRATION_ENABLED=y
CONFIG_APP_VIBRATION_GPIO=26
CONFIG_APP_RGB_LED_ENABLED=y
CONFIG_APP_RGB_LED_RED_GPIO=4
CONFIG_APP_RGB_LED_GREEN_GPIO=19
CONFIG_APP_RGB_LED_BLUE_GPIO=18
CONFIG_APP_OLED_CONTROLLER_SH1106=y
CONFIG_APP_BUTTONS_ENABLED=y
CONFIG_APP_BUTTON_ACK_GPIO=32
CONFIG_APP_BUTTON_WATER_GPIO=33
CONFIG_APP_BUTTON_MUTE_GPIO=34
CONFIG_APP_BUTTON_PAGE_GPIO=35
CONFIG_APP_BUTTON_DEBOUNCE_MS=25
CONFIG_APP_BUTTON_LONG_PRESS_MS=1500
CONFIG_APP_WORKSTATION_LIGHT_ENABLED=y
CONFIG_APP_WORKSTATION_LIGHT_POWER_GPIO=13
CONFIG_APP_WORKSTATION_LIGHT_BRIGHTNESS_GPIO=14
CONFIG_APP_WORKSTATION_LIGHT_COLOR_GPIO=23
CONFIG_APP_WORKSTATION_LIGHT_RELAY_ACTIVE_LOW=y
CONFIG_APP_WORKSTATION_LIGHT_PULSE_MS=180
CONFIG_APP_WORKSTATION_LIGHT_SETTLE_MS=160
CONFIG_APP_WORKSTATION_LIGHT_PRESENCE_AUTO=y
CONFIG_APP_WORKSTATION_LIGHT_PRESENCE_LED_ENABLED=y
CONFIG_APP_WORKSTATION_LIGHT_PRESENCE_LED_GPIO=2
```
